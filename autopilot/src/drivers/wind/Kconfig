## autopilot/src/drivers/wind/Kconfig
```kconfig
menu "Wind"
    menuconfig COMMON_WIND
        bool "Wind sensors"
        default n
        select DRIVERS_WIND_SPEED
        select DRIVERS_WIND_DIRECTION
        ---help---
            Enable default set of wind sensors
    rsource "*/Kconfig"
endmenu #Wind
```

## autopilot/src/drivers/wind/direction/Kconfig
```kconfig
menuconfig DRIVERS_WIND_DIRECTION
	bool "Wind Direction"
	default n
	---help---
		Enable support for wind direction
```

## autopilot/src/drivers/wind/speed/Kconfig
```kconfig
menuconfig DRIVERS_WIND_SPEED
	bool "Wind Speed"
	default n
	---help---
		Enable support for wind speed
```

## autopilot/src/drivers/wing_direction/Kconfig
```kconfig
menuconfig DRIVERS_WING_DIRECTION
	bool "Wing Direction"
	default n
	---help---
		Enable support for wing direction
```

## autopilot/src/modules/sand_yacht_clifton_control/Kconfig
```kconfig
menuconfig MODULES_SAND_YACHT_CLIFTON_CONTROL
	bool "sand_yacht_clifton_control"
	default n
	---help---
		Enable support for sand_yacht_clifton_control

menuconfig USER_SAND_YACHT_CLIFTON_CONTROL
	bool "sand_yacht_clifton_control running as userspace module"
	default y
	depends on BOARD_PROTECTED && MODULES_SAND_YACHT_CLIFTON_CONTROL
	---help---
		Put sand_yacht_clifton_control in userspace memory
```

## autopilot/src/modules/sand_yacht_network/Kconfig
```kconfig
menuconfig MODULES_SAND_YACHT_NETWORK
	bool "sand_yacht_network"
	default n
	---help---
		Enable support for sand_yacht_network

menuconfig USER_SAND_YACHT_NETWORK
	bool "sand_yacht_network running as userspace module"
	default y
	depends on BOARD_PROTECTED && MODULES_SAND_YACHT_NETWORK
	---help---
		Put sand_yacht_network in userspace memory
```

## autopilot/src/modules/sand_yacht_sensors/Kconfig
```kconfig
menuconfig MODULES_SAND_YACHT_SENSORS
	bool "sand_yacht_sensors"
	default n
	---help---
		Enable support for sand_yacht_sensors

menuconfig USER_SAND_YACHT_SENSORS
	bool "sand_yacht_sensors running as userspace module"
	default y
	depends on BOARD_PROTECTED && MODULES_SAND_YACHT_SENSORS
	---help---
		Put sand_yacht_sensors in userspace memory
```

## autopilot/src/modules/sand_yacht_winddir/Kconfig
```kconfig
menuconfig MODULES_SAND_YACHT_WINDDIR
	bool "sand_yacht_winddir"
	default n
	---help---
		Enable support for sand_yacht_winddir

menuconfig USER_SAND_YACHT_SENSORS
	bool "sand_yacht_winddir running as userspace module"
	default y
	depends on BOARD_PROTECTED && MODULES_SAND_YACHT_WINDDIR
	---help---
		Put sand_yacht_winddir in userspace memory
```

## autopilot/src/modules/sand_yacht_windspeed/Kconfig
```kconfig
menuconfig MODULES_SAND_YACHT_WINDSPEED
	bool "sand_yacht_windspeed"
	default n
	---help---
		Enable support for sand_yacht_windspeed

menuconfig USER_SAND_YACHT_WINDSPEED
	bool "sand_yacht_windspeed running as userspace module"
	default y
	depends on BOARD_PROTECTED && MODULES_SAND_YACHT_WINDSPEED
	---help---
		Put sand_yacht_windspeed in userspace memory
```

## autopilot/src/modules/sand_yacht_wingdir/Kconfig
```kconfig
menuconfig MODULES_SAND_YACHT_WINGDIR
	bool "sand_yacht_winggir"
	default n
	---help---
		Enable support for sand_yacht_wingdir

menuconfig USER_SAND_YACHT_WINGDIR
	bool "sand_yacht_wingdir running as userspace module"
	default y
	depends on BOARD_PROTECTED && MODULES_SAND_YACHT_WINGDIR
	---help---
		Put sand_yacht_wingdir in userspace memory
```
